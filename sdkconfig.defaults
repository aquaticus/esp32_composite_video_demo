## sdkconfig.defaults
```kconfig
# Optimize for performance
CONFIG_COMPILER_OPTIMIZATION_PERF=y

CONFIG_ESP32_DEFAULT_CPU_FREQ_240=y
CONFIG_ESP32S2_DEFAULT_CPU_FREQ_240=y
CONFIG_ESP32S3_DEFAULT_CPU_FREQ_240=y

CONFIG_VIDEO_ENABLE_LVGL_SUPPORT=y
CONFIG_LVGL_VSYNC=y
CONFIG_VIDEO_LVGL_INCLUDE_PATH="../../lvgl/lvgl.h"
CONFIG_VIDEO_DIAG_DISPLAY_TEST_FUNC=y

CONFIG_LV_COLOR_DEPTH_8=y
CONFIG_LV_FONT_MONTSERRAT_14=y
CONFIG_LV_FONT_DEFAULT_MONTSERRAT_14=y
CONFIG_LV_BUILD_EXAMPLES=n
```
